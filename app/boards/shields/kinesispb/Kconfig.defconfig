## app/boards/shields/kinesispb/Kconfig.defconfig
```kconfig
# Copyright (c) 2020 The ZMK Contributors
# SPDX-License-Identifier: MIT

if SHIELD_KINESISPB

config ZMK_KEYBOARD_NAME
    default "Kinesis PillBug"

config SPI
    default y

config ZMK_RGB_UNDERGLOW
    select WS2812_STRIP
    select SPI

endif # SHIELD_KINESISPB
```
